## radium-layers/meta-radium/conf/distro/radium-eglfs.conf
```bitbake
 
#@NAME: radium-eglfs
#@DESCRIPTION: Radium distro based on OpenSTLinux with eglfs
require conf/distro/include/st-default-distro-rules.inc
require conf/distro/include/openstlinux.inc

# =========================================================================
# DISTRO namings and integration
# =========================================================================
MAINTAINER = "radium88"

DISTRO = "radium-eglfs"
DISTRO_NAME = "Radium distro for eglfs backend"
DISTRO_VERSION = "1.3"
DISTRO_CODENAME ?= "kirkstone"

# Warning: TARGET_VENDOR does not contains a valid OS/ARCH name like : linux, arm
# Warning: '-' are forbidden between each word of TARGET_VENDOR
TARGET_VENDOR = "-radium_eglfs"

# Warning: '-' are forbidden between each word of SDK_VENDOR
SDK_VENDOR = "-radium_eglfs"
SDK_VERSION = "${DISTRO_CODENAME}_v${DISTRO_VERSION}"

# Add image name for generated SDK and set default SDK install folder
SDK_NAME = "${IMAGE_LINK_NAME}-${SDK_ARCH}"
SDKPATH = "/opt/emtrion/${MACHINE}/${SDK_VERSION}"
SDKPATH[vardepsexclude] = "DATETIME DATE"

IMAGE_NAME = "${IMAGE_BASENAME}-${MACHINE}-${DISTRO_CODENAME}-v${DISTRO_VERSION}-${DATETIME}"
IMAGE_NAME[vardepsexclude] = "DATETIME DATE"

#@DESCRIPTION: ST default distro providers

PREFERRED_PROVIDER_libevent = "libevent-fb"
PREFERRED_PROVIDER_jpeg = "libjpeg-turbo"
PREFERRED_PROVIDER_jpeg-native = "libjpeg-turbo-native"

#--------------------------
# Preferred provider
# for openvt tools
PREFERRED_PROVIDER_console-tools = "kbd"

#--------------------------
# Preferred provider
# splash
SPLASH = "${@bb.utils.contains('COMBINED_FEATURES', 'splashscreen', 'psplash', '', d)}"
PREFERRED_PROVIDER_virtual/psplash = "${@bb.utils.contains('COMBINED_FEATURES', 'splashscreen', 'psplash', '', d)}"
# =========================================================================
# DISTRO settings
# =========================================================================

GCNANO_USERLAND_USE_VENDOR_DIR = "0"

# Settings to be removed from OpenST
#IMAGE_INSTALL_remove = " systemd-mount-bootfs-userfs "
AUTORESIZE = "" 

DISTRO_FEATURES:append = " opengl "
DISTRO_FEATURES:append = " gplv3 "
DISTRO_FEATURES:remove = " wayland x11 optee"
DISTRO_FEATURES:remove = " usbgadget"
DISTRO_FEATURES:remove = " polkit"
DISTRO_FEATURES:remove = " efi"
DISTRO_FEATURES:remove = " autoresize"

# suppress gnome warnings when x11 is disabled
SKIP_META_GNOME_SANITY_CHECK = "1"

# QA check settings - a little stricter than the OE-Core defaults
WARN_TO_ERROR_QA = "already-stripped compile-host-path install-host-path \
                    installed-vs-shipped ldflags pn-overrides rpaths staticdev \
                    unknown-configure-option useless-rpaths"
WARN_QA:remove = "${WARN_TO_ERROR_QA}"
ERROR_QA:append = " ${WARN_TO_ERROR_QA}"
```

## radium-layers/meta-radium/conf/layer.conf
```bitbake
# We have a conf and classes directory, append to BBPATH
BBPATH .= ":${LAYERDIR}"

# We have a recipes directory, add to BBFILES
BBFILES += "${LAYERDIR}/recipes*/*/*.bb ${LAYERDIR}/recipes*/*/*.bbappend"

BBFILE_COLLECTIONS += "meta-radium"
BBFILE_PATTERN_meta-radium := "^${LAYERDIR}/"
BBFILE_PRIORITY_meta-radium = "5"

#Added
LAYERSERIES_COMPAT_meta-radium = "dunfell kirkstone"
```

## radium-layers/meta-radium/conf/machine/include/gpu_add.inc
```bitbake
# =========================================================================
# gpu
# =========================================================================
# To support gpu on a machine,
# please add "gpu" to MACHINE_FEATURES in machine conf file
GPU_LIST ?= "\
    gcnano-driver-stm32mp \
    ${GPU_USERLAND_LIBRARIES_INSTALL} \
    "
GPU_IMAGE_INSTALL = "${@bb.utils.contains('MACHINE_FEATURES', 'gpu', '${GPU_LIST}', '', d)} "
```

## radium-layers/meta-radium/conf/machine/radium-machine.conf
```bitbake
#@TYPE: Machine
#@NAME: radium-machine
#@DESCRIPTION: stm32mp157c-radium
#@NEEDED_BSPLAYERS: layers/meta-openembedded/meta-oe layers/meta-openembedded/meta-python

include conf/machine/include/st-machine-common-stm32mp.inc
include conf/machine/include/st-machine-providers-stm32mp.inc

# Define specific familly common machine name
MACHINEOVERRIDES .= ":stm32mp1common:stm32mp15common"

# =========================================================================
# Chip architecture
# =========================================================================
DEFAULTTUNE = "cortexa7thf-neon-vfpv4"
include conf/machine/include/arm/armv7a/tune-cortexa7.inc

# =========================================================================
# boot scheme
# =========================================================================
BOOTSCHEME_LABELS += "trusted"
#BOOTSCHEME_LABELS += "optee"

# =========================================================================
# boot device
# =========================================================================
# Define the boot device supported
BOOTDEVICE_LABELS += "emmc"
#BOOTDEVICE_LABELS += "nand-4-256"
BOOTDEVICE_LABELS += "nor-sdcard"
BOOTDEVICE_LABELS += "sdcard"

ENABLE_FLASHLAYOUT_CONFIG = "0"

# =========================================================================
# Machine features
# =========================================================================
MACHINE_FEATURES += "splashscreen"
MACHINE_FEATURES += "watchdog"
#MACHINE_FEATURES += "bluetooth"
#MACHINE_FEATURES += "wifi"
MACHINE_FEATURES += "${@'gpu' if d.getVar('ACCEPT_EULA_'+d.getVar('MACHINE')) == '1' else ''}"
MACHINE_FEATURES += "m4copro"
MACHINE_FEATURES += "fit"


# Bluetooth
#BLUETOOTH_LIST += "linux-firmware-bluetooth-bcm4343"
# Wifi
#WIFI_LIST += "linux-firmware-bcm43430"


# =========================================================================
# Device Storage
# =========================================================================
# Enable the board device storage support with STM32MP_DEVICETREE according to BOOTDEVICE_LABELS
DEVICE_BOARD_ENABLE:NAND    += "${@bb.utils.contains('BOOTDEVICE_LABELS', 'nand-4-256', '${STM32MP_DEVICETREE}', '', d)}"
DEVICE_BOARD_ENABLE:NOR     += "${@bb.utils.contains('BOOTDEVICE_LABELS', 'nor-sdcard' , '${STM32MP_DEVICETREE}', '', d)}"
DEVICE_BOARD_ENABLE:EMMC    += "${@bb.utils.contains('BOOTDEVICE_LABELS', 'emmc', '${STM32MP_DEVICETREE}', '', d)}"
DEVICE_BOARD_ENABLE:SDCARD  += "${@bb.utils.contains('BOOTDEVICE_LABELS', 'sdcard', '${STM32MP_DEVICETREE}', '', d)}"

# =========================================================================
# Flashlayout
# =========================================================================
# Set the FLASHLAYOUT_TYPE_LABELS to STM32MP_DEVICETREE according to BOOTDEVICE_LABELS
FLASHLAYOUT_TYPE_LABELS:emmc        = "${@bb.utils.contains('BOOTDEVICE_LABELS', 'emmc', '${STM32MP_DEVICETREE}', '', d)}"
FLASHLAYOUT_TYPE_LABELS:nand-4-256  = "${@bb.utils.contains('BOOTDEVICE_LABELS', 'nand-4-256', '${STM32MP_DEVICETREE}', '', d)}"
FLASHLAYOUT_TYPE_LABELS:nor-sdcard  = "${@bb.utils.contains('BOOTDEVICE_LABELS', 'nor-sdcard' , '${STM32MP_DEVICETREE}', '', d)}"
FLASHLAYOUT_TYPE_LABELS:sdcard      = "${@bb.utils.contains('BOOTDEVICE_LABELS', 'sdcard', '${STM32MP_DEVICETREE}', '', d)}"

# =========================================================================
# Kernel
# =========================================================================
# For eval board: auto-load goodix module (touchscreen module)
KERNEL_MODULE_AUTOLOAD = "goodix"
STM32MP_DEVICETREE = "stm32mp157c-radium"

#KERNEL_IMAGETYPE += "zImage"

# =========================================================================
# M4 copro
# =========================================================================
# Define the devicetree for M4 example
#CUBE_M4_EXAMPLES_DT += "stm32mp157c-dk2-m4-examples"
#CUBE_M4_EXAMPLES_DT += "stm32mp157c-ev1-m4-examples"
#CUBE_M4_EXAMPLES_DT += "stm32mp157f-dk2-m4-examples"
CUBE_M4_EXAMPLES_DT += "stm32mp157f-ev1-m4-examples"

# Define specific board reference to use
# For M4 BOARD config, STM32MP157C are similar to STM32MP157F
#M4_BOARDS = "STM32MP157C-EV1"

# =========================================================================
# extlinux configuration
# =========================================================================
# As example, modify the default boot config for each target to M4 config
#UBOOT_EXTLINUX_DEFAULT_LABEL_stm32mp157c-ev1 = "stm32mp157c-ev1-m4-examples"

# =========================================================================
# WIC for sdcard raw image
# =========================================================================
WIC_CREATE_EXTRA_ARGS = "--no-fstab-update"
WKS_FILE_DEPENDS ?= " \
    virtual/bootloader \
    virtual/trusted-firmware-a \
    ${@bb.utils.contains('BOOTSCHEME_LABELS', 'optee', 'virtual/optee-os', '', d)} \
    st-image-bootfs \
    ${@bb.utils.contains('ST_VENDORFS','1','st-image-vendorfs', '', d)} \
    st-image-userfs \
"
TRUSTED_WIC_FILE = "${@bb.utils.contains('ST_VENDORFS','1','sdcard-stm32mp157f-ev1-trusted-vendorfs-1GB.wks.in','sdcard-stm32mp157f-ev1-trusted-1GB.wks.in',d)}"

# for generated a WIC file, please uncomment the 2 following lines or add them to local.conf
#WKS_IMAGE_FSTYPES += "wic wic.bz2 wic.bmap"
#WKS_FILE += "${TRUSTED_WIC_FILE}"

# ---------------------------------
#  Usage of FIT Image signed
# ---------------------------------
# Need to have MACHINE_FEATURES += "fit"
# Need to uncomment the follwing variable
# NOTE: you can specify another directlry to keep same key at each new compilation (UBOOT_SIGN_KEYDIR)

# keys name in keydir (eg. "ubootfit.crt", "ubootfit.key")
#UBOOT_SIGN_KEYNAME = "ubootfit"
#UBOOT_MKIMAGE_DTCOPTS = "-I dts -O dtb -p 2000"
#UBOOT_SIGN_ENABLE = "1"
#UBOOT_SIGN_KEYDIR = "${DEPLOY_DIR_IMAGE}"

#FIT_GENERATE_KEYS = "1"
```
